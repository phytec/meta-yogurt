## conf/distro/yogurt-gateway.conf
```bitbake
require yogurt.conf

DISTRO = "yogurt-gateway"
DISTRO_NAME = "Yogurt Gateway (Phytec Gateway Distribution)"

DISTRO_VERSION_rk3288 = "BSP-Yocto-IoTEdge-RK3288-v1.3-rc1"

DISTRO_FEATURES += "virtualization"
```

## conf/distro/yogurt-vendor-xwayland.conf
```bitbake
require yogurt-vendor.conf

DISTRO = "yogurt-vendor-xwayland"
DISTRO_NAME = "Yogurt Vendor xwayland (Phytec Vendor Distribution)"

DISTRO_FEATURES += "x11 wayland vulkan opengl"

PREFERRED_VERSION_opencv_mx8 = "3.%"
```

## conf/distro/yogurt-vendor.conf
```bitbake
require conf/distro/poky.conf
require common.inc

DISTRO = "yogurt-vendor"
DISTRO_NAME = "Yogurt Vendor (Phytec Vendor Distribution)"

DISTRO_FEATURES_DEFAULT_remove = "argp irda pcmcia x11"
DISTRO_FEATURES = "${DISTRO_FEATURES_DEFAULT} ${DISTRO_FEATURES_LIBC}"
DISTRO_FEATURES += "pam systemd vendor"

VIRTUAL-RUNTIME_dev_manager = "udev"
VIRTUAL-RUNTIME_init_manager = "systemd"
DISTRO_FEATURES_BACKFILL_CONSIDERED += "sysvinit"
VIRTUAL-RUNTIME_login_manager = "busybox"
VIRTUAL-RUNTIME_syslog = ""
VIRTUAL-RUNTIME_initscripts = ""

BBMASK_mx8 += "meta-freescale/recipes-graphics/wayland/wayland_1.15.%.bbappend"
BBMASK_mx8 += "meta-freescale/recipes-graphics/drm/libdrm_%.bbappend"
BBMASK_mx8 += "poky/meta/recipes-graphics/vulkan/vulkan_1.0.65.2.bb"
BBMASK_mx8 += "meta-freescale/dynamic-layers/qt5-layer/recipes-qt/qt5/qtbase_%.bbappend"

# some default locales
IMAGE_LINGUAS ?= "de-de fr-fr en-us"

PREFERRED_PROVIDER_virtual/kernel_mx6ul = "linux-imx"
```
